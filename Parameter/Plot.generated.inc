/* Generated from Parameter/parameter.yaml. DO NOT EDIT. */
{ PARAM_ADC_IA, AXDR_PLOT_CAP_FAST | AXDR_PLOT_CAP_NORMAL, 0.001f, &ADC.Ia_A },
{ PARAM_ADC_IB, AXDR_PLOT_CAP_FAST | AXDR_PLOT_CAP_NORMAL, 0.001f, &ADC.Ib_A },
{ PARAM_ADC_IC, AXDR_PLOT_CAP_FAST | AXDR_PLOT_CAP_NORMAL, 0.001f, &ADC.Ic_A },
{ PARAM_ADC_VBUS, AXDR_PLOT_CAP_NORMAL, 0.0f, &ADC.Vbus_V },
{ PARAM_RUN_ID, AXDR_PLOT_CAP_FAST | AXDR_PLOT_CAP_NORMAL, 0.001f, &Motor_Run.Id },
{ PARAM_RUN_IQ, AXDR_PLOT_CAP_FAST | AXDR_PLOT_CAP_NORMAL, 0.001f, &Motor_Run.Iq },
{ PARAM_RUN_UD, AXDR_PLOT_CAP_FAST | AXDR_PLOT_CAP_NORMAL, 0.001f, &Motor_Run.Ud },
{ PARAM_RUN_UQ, AXDR_PLOT_CAP_FAST | AXDR_PLOT_CAP_NORMAL, 0.001f, &Motor_Run.Uq },
{ PARAM_RUN_THETA_E, AXDR_PLOT_CAP_FAST | AXDR_PLOT_CAP_NORMAL, 0.0002f, &Motor_Run.Theta_e },
{ PARAM_RUN_UALPHA, AXDR_PLOT_CAP_FAST | AXDR_PLOT_CAP_NORMAL, 0.001f, &Motor_Run.Ualpha },
{ PARAM_RUN_UBETA, AXDR_PLOT_CAP_FAST | AXDR_PLOT_CAP_NORMAL, 0.001f, &Motor_Run.Ubeta },
{ PARAM_OBS_THETA, AXDR_PLOT_CAP_FAST | AXDR_PLOT_CAP_NORMAL, 0.0002f, &Flux_PLL.State.Theta },
{ PARAM_OBS_WE, AXDR_PLOT_CAP_FAST | AXDR_PLOT_CAP_NORMAL, 0.1f, &Flux_PLL.State.We },
{ PARAM_MECH_ESO_THETA, AXDR_PLOT_CAP_FAST | AXDR_PLOT_CAP_NORMAL, 0.0002f, &Mechanical_ESO.State.Theta },
{ PARAM_MECH_ESO_WM, AXDR_PLOT_CAP_FAST | AXDR_PLOT_CAP_NORMAL, 0.1f, &Mechanical_ESO.State.Wm },
{ PARAM_MECH_ESO_TD, AXDR_PLOT_CAP_FAST | AXDR_PLOT_CAP_NORMAL, 0.001f, &Mechanical_ESO.State.Td },
{ PARAM_MECH_ESO_ERROR, AXDR_PLOT_CAP_FAST | AXDR_PLOT_CAP_NORMAL, 0.0002f, &Mechanical_ESO.State.Error },
