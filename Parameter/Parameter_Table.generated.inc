/* Generated from Parameter/parameter_objects.yaml. DO NOT EDIT. */
{ PARAM_ADC_IA, PARAM_FLOAT, &ADC.Ia_A, -INFINITY, INFINITY, 0U, PARAM_CHANGE_NONE },
{ PARAM_ADC_IB, PARAM_FLOAT, &ADC.Ib_A, -INFINITY, INFINITY, 0U, PARAM_CHANGE_NONE },
{ PARAM_ADC_IC, PARAM_FLOAT, &ADC.Ic_A, -INFINITY, INFINITY, 0U, PARAM_CHANGE_NONE },
{ PARAM_ADC_VBUS, PARAM_FLOAT, &ADC.Vbus_V, -INFINITY, INFINITY, 0U, PARAM_CHANGE_NONE },
{ PARAM_RUN_ID, PARAM_FLOAT, &Motor_Run.Id, -INFINITY, INFINITY, 0U, PARAM_CHANGE_NONE },
{ PARAM_RUN_IQ, PARAM_FLOAT, &Motor_Run.Iq, -INFINITY, INFINITY, 0U, PARAM_CHANGE_NONE },
{ PARAM_RUN_UD, PARAM_FLOAT, &Motor_Run.Ud, -INFINITY, INFINITY, 0U, PARAM_CHANGE_NONE },
{ PARAM_RUN_UQ, PARAM_FLOAT, &Motor_Run.Uq, -INFINITY, INFINITY, 0U, PARAM_CHANGE_NONE },
{ PARAM_RUN_THETA_E, PARAM_FLOAT, &Motor_Run.Theta_e, -INFINITY, INFINITY, 0U, PARAM_CHANGE_NONE },
{ PARAM_RUN_UALPHA, PARAM_FLOAT, &Motor_Run.Ualpha, -INFINITY, INFINITY, 0U, PARAM_CHANGE_NONE },
{ PARAM_RUN_UBETA, PARAM_FLOAT, &Motor_Run.Ubeta, -INFINITY, INFINITY, 0U, PARAM_CHANGE_NONE },
{ PARAM_OBS_THETA, PARAM_FLOAT, &Flux_PLL.State.Theta, -INFINITY, INFINITY, 0U, PARAM_CHANGE_NONE },
{ PARAM_OBS_WE, PARAM_FLOAT, &Flux_PLL.State.We, -INFINITY, INFINITY, 0U, PARAM_CHANGE_NONE },
{ PARAM_OBS_PLL_ERR, PARAM_FLOAT, &Flux_PLL.State.Err, -INFINITY, INFINITY, 0U, PARAM_CHANGE_NONE },
{ PARAM_OBS_FLUX_ERR, PARAM_FLOAT, &Flux_Obs.State.Flux_Err, -INFINITY, INFINITY, 0U, PARAM_CHANGE_NONE },
{ PARAM_MOTOR_PP, PARAM_U8, &Motor_Para.Pp, 1.0f, 64.0f, PARAM_FLAG_HOST_WRITE | PARAM_FLAG_DISABLED_ONLY, PARAM_CHANGE_MOTOR_PP },
{ PARAM_MOTOR_RS, PARAM_FLOAT, &Motor_Para.Rs, 0.0f, INFINITY, PARAM_FLAG_HOST_WRITE | PARAM_FLAG_DISABLED_ONLY, PARAM_CHANGE_MOTOR_RL },
{ PARAM_MOTOR_LD, PARAM_FLOAT, &Motor_Para.Ld, 0.0f, INFINITY, PARAM_FLAG_HOST_WRITE | PARAM_FLAG_DISABLED_ONLY, PARAM_CHANGE_MOTOR_RL },
{ PARAM_MOTOR_LQ, PARAM_FLOAT, &Motor_Para.Lq, 0.0f, INFINITY, PARAM_FLAG_HOST_WRITE | PARAM_FLAG_DISABLED_ONLY, PARAM_CHANGE_MOTOR_RL },
{ PARAM_MOTOR_FLUX, PARAM_FLOAT, &Motor_Para.Flux, 0.0f, INFINITY, PARAM_FLAG_HOST_WRITE | PARAM_FLAG_DISABLED_ONLY, PARAM_CHANGE_MOTOR_FLUX },
{ PARAM_MOTOR_J, PARAM_FLOAT, &Motor_Para.J, 0.0f, INFINITY, PARAM_FLAG_HOST_WRITE | PARAM_FLAG_DISABLED_ONLY, PARAM_CHANGE_MOTOR_JB },
{ PARAM_MOTOR_B, PARAM_FLOAT, &Motor_Para.B, 0.0f, INFINITY, PARAM_FLAG_HOST_WRITE | PARAM_FLAG_DISABLED_ONLY, PARAM_CHANGE_MOTOR_JB },
{ PARAM_MOTOR_DIR, PARAM_I8, &Motor_Config.Dir, -1.0f, 1.0f, PARAM_FLAG_HOST_WRITE | PARAM_FLAG_DISABLED_ONLY, PARAM_CHANGE_NONE },
{ PARAM_LIMIT_I_MAX, PARAM_FLOAT, &User_Lim.I_Max, 0.0f, INFINITY, PARAM_FLAG_HOST_WRITE | PARAM_FLAG_DISABLED_ONLY, PARAM_CHANGE_NONE },
{ PARAM_LIMIT_WM_MAX, PARAM_FLOAT, &User_Lim.Wm_Max, 0.0f, INFINITY, PARAM_FLAG_HOST_WRITE | PARAM_FLAG_DISABLED_ONLY, PARAM_CHANGE_NONE },
{ PARAM_ENCODER_TYPE, PARAM_U8, &Encoder_Config.Type, (float)ENC_MT6816, (float)ENC_MT6835, PARAM_FLAG_HOST_WRITE | PARAM_FLAG_DISABLED_ONLY, PARAM_CHANGE_ENCODER },
{ PARAM_ENCODER_READY, PARAM_U8, &Encoder.Ready, 0.0f, 1.0f, 0U, PARAM_CHANGE_NONE },
{ PARAM_ENCODER_VALID, PARAM_U8, &Encoder.Valid, 0.0f, 1.0f, 0U, PARAM_CHANGE_NONE },
{ PARAM_ENCODER_FAULT, PARAM_U8, &Encoder.Fault, 0.0f, 1.0f, 0U, PARAM_CHANGE_NONE },
{ PARAM_PHASE_I_SEARCH, PARAM_FLOAT, &Servo_Phase_Config.I_Search_A, 0.0f, (float)SERVO_PHASE_I_MAX_A, PARAM_FLAG_HOST_WRITE | PARAM_FLAG_DISABLED_ONLY, PARAM_CHANGE_NONE },
{ PARAM_CAL_VALID, PARAM_U8, &Motor_Cal.Valid, 0.0f, 1.0f, 0U, PARAM_CHANGE_NONE },
{ PARAM_CAL_ENC_DIR, PARAM_I8, &Motor_Cal.Enc_Dir, -1.0f, 1.0f, 0U, PARAM_CHANGE_NONE },
{ PARAM_CAL_THETA_OFF, PARAM_FLOAT, &Motor_Cal.Theta_Off, -INFINITY, INFINITY, 0U, PARAM_CHANGE_NONE },
{ PARAM_PHASE_THETA_OFF_ERROR, PARAM_FLOAT, NULL, -INFINITY, INFINITY, 0U, PARAM_CHANGE_NONE },
{ PARAM_PHASE_VERIFY_MOVE, PARAM_FLOAT, NULL, -INFINITY, INFINITY, 0U, PARAM_CHANGE_NONE },
{ PARAM_RUN_THETA_M, PARAM_FLOAT, &Motor_Run.Theta_m, -INFINITY, INFINITY, 0U, PARAM_CHANGE_NONE },
{ PARAM_RUN_WM, PARAM_FLOAT, &Motor_Run.Wm, -INFINITY, INFINITY, 0U, PARAM_CHANGE_NONE },
{ PARAM_RUN_TURN, PARAM_I32, &Motor_Run.Turn, -INFINITY, INFINITY, 0U, PARAM_CHANGE_NONE },
{ PARAM_MOTION_WM_MAX, PARAM_FLOAT, &Motion_Config.Wm_Max, 0.0f, INFINITY, PARAM_FLAG_HOST_WRITE, PARAM_CHANGE_NONE },
{ PARAM_MOTION_WM_ACC, PARAM_FLOAT, &Motion_Config.Wm_Acc, 0.0f, INFINITY, PARAM_FLAG_HOST_WRITE, PARAM_CHANGE_NONE },
{ PARAM_MOTION_WM_DEC, PARAM_FLOAT, &Motion_Config.Wm_Dec, 0.0f, INFINITY, PARAM_FLAG_HOST_WRITE, PARAM_CHANGE_NONE },
{ PARAM_MOTOR_MODE, PARAM_U8, &Motor_Mode, (float)TORQUE, (float)PHASE_SEARCH, PARAM_FLAG_HOST_WRITE | PARAM_FLAG_DISABLED_ONLY, PARAM_CHANGE_NONE },
{ PARAM_TARGET_TORQUE, PARAM_FLOAT, &Motor_Cmd.Te_Target, -INFINITY, INFINITY, PARAM_FLAG_HOST_WRITE, PARAM_CHANGE_NONE },
{ PARAM_TARGET_SPEED, PARAM_FLOAT, &Motor_Cmd.Wm_Target, -INFINITY, INFINITY, PARAM_FLAG_HOST_WRITE, PARAM_CHANGE_NONE },
{ PARAM_TARGET_POSITION, PARAM_POSITION, &Motor_Cmd.Position_Target, -INFINITY, INFINITY, PARAM_FLAG_HOST_WRITE, PARAM_CHANGE_NONE },
{ PARAM_MOTOR_STATE, PARAM_U8, NULL, (float)DISABLED, (float)RUN, 0U, PARAM_CHANGE_NONE },
{ PARAM_EVENT_REPORT, PARAM_U32, &Protection.Report, -INFINITY, INFINITY, 0U, PARAM_CHANGE_NONE },
{ PARAM_EVENT_WARNING, PARAM_U32, &Protection.Warning, -INFINITY, INFINITY, 0U, PARAM_CHANGE_NONE },
{ PARAM_EVENT_ERROR, PARAM_U32, &Protection.Stop, -INFINITY, INFINITY, 0U, PARAM_CHANGE_NONE },
{ PARAM_EVENT_TRIP, PARAM_U32, &Protection.Trip, -INFINITY, INFINITY, 0U, PARAM_CHANGE_NONE },
{ PARAM_IDENT_RS_LS_VALID, PARAM_U8, NULL, 0.0f, 1.0f, 0U, PARAM_CHANGE_NONE },
{ PARAM_IDENT_RS_RESULT, PARAM_FLOAT, NULL, -INFINITY, INFINITY, 0U, PARAM_CHANGE_NONE },
{ PARAM_IDENT_LS_RESULT, PARAM_FLOAT, NULL, -INFINITY, INFINITY, 0U, PARAM_CHANGE_NONE },
{ PARAM_IDENT_FLUX_VALID, PARAM_U8, NULL, 0.0f, 1.0f, 0U, PARAM_CHANGE_NONE },
{ PARAM_IDENT_FLUX_RESULT, PARAM_FLOAT, NULL, -INFINITY, INFINITY, 0U, PARAM_CHANGE_NONE },
{ PARAM_SENSORLESS_STATE, PARAM_U8, NULL, (float)SL_ALIGN, (float)SL_IDLE, 0U, PARAM_CHANGE_NONE },
